## main/Kconfig.projbuild
```kconfig
# main/Kconfig.projbuild
# AI 语音助手(demo_voice)的运行参数。
# 在 `idf.py menuconfig` -> "AI Voice Assistant (demo_voice)" 里填写真实值。
menu "AI Voice Assistant (demo_voice)"

    config VOICE_WIFI_SSID
        string "Wi-Fi SSID (AP 名称, 2.4GHz)"
        default "Mate 70 Pro"

    config VOICE_WIFI_PASSWORD
        string "Wi-Fi password"
        default "15062106537"

    config VOICE_SERVER_URL
        string "Jarvis brain /speak URL"
        default "http://192.168.43.4:8000/speak"
        help
            jarvis-brain 服务地址。运行 `python server.py` 后，
            填成 http://<服务器IP>:8000/speak(注意末尾是 /speak)。

    config VOICE_SN
        string "Device SN (设备标识, 用于区分记忆)"
        default "AIPASS0001"

    config VOICE_RECORD_SEC
        int "Max record seconds"
        range 1 12
        default 6
        help
            录音采用 8kHz 采样,1 秒约占 16KB 内部 RAM(ESP32-C3 无 PSRAM)。
            默认 6 秒;RAM 不足时固件自动减半直到装得下,
            屏幕待机时会显示实际可录秒数,录满自动发送。

endmenu
```
